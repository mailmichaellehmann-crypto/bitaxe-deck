## firmware/main/Kconfig.projbuild
```kconfig
menu "Bitaxe Deck"
    config DECK_OTA_REPO
        string "GitHub-Repository für Updates (besitzer/name)"
        default "mailmichaellehmann-crypto/bitaxe-deck"
        help
            Das Display sucht unter https://github.com/<besitzer>/<name>/releases/latest
            nach der Datei bitaxe_deck.bin.

    config DECK_DISPLAY_FLIP
        bool "Display um 180° drehen"
        default n
        help
            Dreht Bild und Touch um 180°, falls das Display auf dem Kopf steht.
    config DECK_PERF_LOG
        bool "Bildrate im Log ausgeben"
        default n
        help
            Gibt alle 2 s Bilder pro Sekunde und Renderzeiten über die serielle Konsole aus.

    config DECK_PERF_BENCH
        bool "Automatisch durch die Karten blättern (Messung)"
        depends on DECK_PERF_LOG
        default n

    config DECK_SNAPSHOT
        bool "Screenshots aller Karten über USB ausgeben (statt Messung)"
        depends on DECK_PERF_BENCH
        default n
        help
            Wartet auf Live-Daten und schickt dann jede Karte als Bild über die serielle
            Konsole (Base64, RGB565). tools/snapshots.py macht daraus PNG-Dateien.
endmenu
```

## firmware/sdkconfig.defaults
```kconfig
# --- Board: WT32-SC01 Plus (ESP32-S3, 16 MB Flash, 2 MB Quad-PSRAM) ---
CONFIG_IDF_TARGET="esp32s3"
CONFIG_ESPTOOLPY_FLASHSIZE_16MB=y
CONFIG_ESPTOOLPY_FLASHMODE_QIO=y
CONFIG_PARTITION_TABLE_CUSTOM=y
CONFIG_PARTITION_TABLE_CUSTOM_FILENAME="partitions.csv"
CONFIG_ESP_DEFAULT_CPU_FREQ_MHZ_240=y
CONFIG_COMPILER_OPTIMIZATION_PERF=y

CONFIG_SPIRAM=y
CONFIG_SPIRAM_MODE_QUAD=y
CONFIG_SPIRAM_SPEED_80M=y
CONFIG_SPIRAM_USE_MALLOC=y
CONFIG_SPIRAM_MALLOC_ALWAYSINTERNAL=4096
CONFIG_SPIRAM_MALLOC_RESERVE_INTERNAL=65536
CONFIG_SPIRAM_TRY_ALLOCATE_WIFI_LWIP=y

CONFIG_ESP_MAIN_TASK_STACK_SIZE=8192
CONFIG_FREERTOS_HZ=1000
CONFIG_ESP_CONSOLE_USB_SERIAL_JTAG=y

# HTTPS (CoinGecko, mempool.space)
CONFIG_MBEDTLS_CERTIFICATE_BUNDLE=y
CONFIG_MBEDTLS_CERTIFICATE_BUNDLE_DEFAULT_FULL=y
CONFIG_MBEDTLS_EXTERNAL_MEM_ALLOC=y
CONFIG_ESP_HTTP_CLIENT_ENABLE_HTTPS=y
CONFIG_HTTPD_MAX_REQ_HDR_LEN=1024

# --- LVGL 8.4 ---
CONFIG_LV_COLOR_DEPTH_16=y
CONFIG_LV_COLOR_16_SWAP=y
CONFIG_LV_MEM_CUSTOM=y
CONFIG_LV_MEMCPY_MEMSET_STD=y
CONFIG_LV_DISP_DEF_REFR_PERIOD=16
CONFIG_LV_INDEV_DEF_READ_PERIOD=10
CONFIG_LV_DPI_DEF=160
CONFIG_LV_USE_LOG=n
CONFIG_LV_USE_PERF_MONITOR=n
CONFIG_LV_FONT_MONTSERRAT_14=y
CONFIG_LV_USE_FONT_COMPRESSED=n
CONFIG_LV_ATTRIBUTE_FAST_MEM_USE_IRAM=y
CONFIG_LV_DITHER_GRADIENT=y
CONFIG_LV_GRAD_CACHE_DEF_SIZE=32768
CONFIG_LV_SHADOW_CACHE_SIZE=0
CONFIG_LV_USE_QRCODE=y
CONFIG_LV_MEM_CUSTOM_INCLUDE="esp_heap_caps.h"

# --- OTA-Updates über GitHub Releases ---
CONFIG_BOOTLOADER_APP_ROLLBACK_ENABLE=y
CONFIG_ESP_HTTPS_OTA_ALLOW_HTTP=n
```
